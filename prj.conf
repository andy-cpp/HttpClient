## CMakeLists.txt
```
cmake_minimum_required(VERSION 3.10)

project(FileDownloader VERSION 0.1 LANGUAGES CXX)

set(CMAKE_CXX_STANDARD 17)
set(CMAKE_CXX_FLAGS "${CMAKE_CXX_FLAGS} -include ${CMAKE_SOURCE_DIR}/include/autoconf.h")

find_package(Python COMPONENTS Interpreter Development REQUIRED)

find_package(CURL CONFIG REQUIRED)

file(GLOB SRCS
    ${PROJECT_SOURCE_DIR}/src/**.cpp
    ${PROJECT_SOURCE_DIR}/src/**.hpp
)

add_executable(FileDownloader ${SRCS})

set(CONFIG_FILENAME "${CMAKE_SOURCE_DIR}/prj.conf")
add_custom_command(
    COMMAND ${CMAKE_COMMAND} --build ${CMAKE_BINARY_DIR} --target clean
    TARGET FileDownloader
    DEPENDS ${CONFIG_FILENAME}
)

add_custom_command(TARGET FileDownloader
PRE_BUILD
COMMAND ${Python_EXECUTABLE} scripts/autoconf.py
COMMENT "Generate autoconf headers"
WORKING_DIRECTORY ${CMAKE_SOURCE_DIR}
)
include_directories(FileDownloader "include/")

target_link_libraries(FileDownloader PRIVATE CURL::libcurl)
```

## KConfig
```
config EXCEPTIONS
    bool "Toggles exceptions on errors"
    default y
config TIMEOUT_MS
    int "Transfer timeout ms"
    default 0
```

## prj.conf
```kconfig
CONFIG_EXCEPTIONS=n
```

## src/main.cpp
```c
#include <iostream>
#include "Request.hpp"
#include "Response.hpp"
#include <thread>

int main()
{
    Request req;
    
    req.Go("https://ipinfo.io", [](Request& r, Response& res){
        std::cout << res.body << "\n";

        exit(0);
    });
    for(;;);
}
```

## src/Common.cpp
```c
#include "Common.hpp"

LinkedList::LinkedList(std::vector<std::string> const& headers)
{
    for(auto& v : headers)
    {
        m_list = curl_slist_append(m_list, v.c_str());
    }
}
```

## src/Common.hpp
```c
#pragma once
#include <memory>
#include <vector>
#include <string>
#include <unordered_map>

#include <curl/curl.h>
#include <curl/easy.h>

class LinkedList
{
public:
    LinkedList(std::vector<std::string> const& headers);

    ~LinkedList()
    {
        curl_slist_free_all(m_list);
    }

    curl_slist* GetList() {return m_list;}

private:
    curl_slist* m_list = 0;
};
```

## src/Header.hpp
```c
#pragma once
#include "Common.hpp"
class Headers
{
public:
    Headers() = default;

    std::string Get(std::string const& key) const
    {
        return m_headers.at(key);
    }

    void Set(std::string const& key, std::string const& value)
    {
        m_headers[key] = value;
    }

    bool Exists(std::string const& key)
    {
        return m_headers.find(key) != m_headers.end();
    }

    LinkedList ToList()
    {
        std::vector<std::string> vec;
        for(auto& h : m_headers)
        {
            vec.push_back(h.first + ": " + h.second);
        }
        return LinkedList(vec);
    }

    std::unordered_map<std::string, std::string>& GetMap(){return m_headers;}
private:
    std::unordered_map<std::string, std::string> m_headers;
};
```

## src/Request.cpp
```c
#include <thread>
#include "Request.hpp"
#include <stdexcept>

Request::Request()
{
    m_handle = curl_easy_init();
    #if CONFIG_TIMEOUT_MS != 0
    curl_easy_setopt(m_handle, CURLOPT_TIMEOUT_MS, CONFIG_TIMEOUT_MS);
    #endif
}

void Request::SetHeader(std::string const& key, std::string const& value)
{
    m_headers.Set(key, value);
}

void Request::SetHeaders(std::vector<std::pair<std::string, std::string>> const& headers)
{
    for(auto& header : headers)
    {
        m_headers.Set(header.first, header.second);
    }
}

void Request::SetBody(std::string const& body)
{
    m_body = body;
    curl_easy_setopt(m_handle, CURLOPT_POSTFIELDS, m_body.c_str());
    curl_easy_setopt(m_handle, CURLOPT_POSTFIELDSIZE, m_body.size());
}

void Request::ThreadHandler(std::string const& url, Request::callback_t callback)
{
    Response& response = this->Go(url);

    callback(*this, response);
}

void Request::Go(std::string const& url, callback_t callback)
{
    std::thread(&ThreadHandler, this,url, callback).detach();
}

Response& Request::Go(std::string const& url)
{
    m_response.PrePerform(m_handle);
    
    LinkedList headerlist = m_headers.ToList();
    curl_easy_setopt(m_handle, CURLOPT_HTTPHEADER, headerlist.GetList());
    curl_easy_setopt(m_handle, CURLOPT_URL, url.c_str());
    curl_easy_perform(m_handle);

    #ifdef CONFIG_EXCEPTIONS
    if(ret != CURLE_OK){
        throw std::runtime_error(std::string("Error performing request: ") + curl_easy_strerror(ret));
    }
    #endif
    m_response.PostPerform();
    return m_response;
}
```

## src/Request.hpp
```c
#pragma once
#include <functional>
#include "Common.hpp"
#include "Response.hpp"
class Request
{
public:
    using callback_t = std::function<void(Request& request, Response& response)>;
    Request();

    ~Request()
    {
        curl_easy_cleanup(m_handle);
    }

    CURL* GetHandle(){return m_handle;}

    void SetHeader(std::string const& key, std::string const& value);

    void SetHeaders(std::vector<std::pair<std::string, std::string>> const& headers);

    void SetBody(std::string const& body);

    template <typename T>
    bool SetOption(CURLoption opt, T const& value)
    {
        return curl_easy_setopt(m_handle, opt, value) == CURLE_OK;
    }

    void Go(std::string const& url, callback_t callback);

    Response& Go(std::string const& url);
private:
    void ThreadHandler(std::string const& url, callback_t cb);

private:
    std::string m_body;
    Headers m_headers;
    Response m_response;
    CURL* m_handle = 0;
};
```

## src/Response.cpp
```c
#include "Response.hpp"

static size_t write_header_cb(char* buffer, size_t size, size_t nitems, Headers* userdata)
{
    char* delim_pos = strchr(buffer, ':');
    if(delim_pos == 0){
        return nitems * size;
    }

    char* key = buffer;
    char* value = delim_pos + 2;
    char* end = strstr(buffer, "\r\n");
    *delim_pos = 0;
    userdata->Set(key, std::string(value, end - value));
    return nitems * size;
}

static size_t write_body_cb(char* buffer, size_t size, size_t nmemb, std::string* userdata)
{
    userdata->append(buffer, std::size_t(nmemb));
    return size * nmemb;
}

void Response::PrePerform(CURL* handle_)
{
    handle = handle_;
    curl_easy_setopt(handle, CURLOPT_WRITEFUNCTION, write_body_cb);
    curl_easy_setopt(handle, CURLOPT_WRITEDATA, &body);

    curl_easy_setopt(handle, CURLOPT_HEADERFUNCTION, write_header_cb);
    curl_easy_setopt(handle, CURLOPT_WRITEHEADER, &headers);
}

void Response::PostPerform()
{
    curl_easy_getinfo(handle, CURLINFO_RESPONSE_CODE, &code);
}
```

## src/Response.hpp
```c
#pragma once
#include "Common.hpp"
#include "Header.hpp"

class Request;

class Response
{
protected:
    friend class Request;
    void PrePerform(CURL* handle);

    void PostPerform();
public:

public:
    long code = 0;
    std::string body;
    Headers headers;
    CURL* handle = 0;
};
```
